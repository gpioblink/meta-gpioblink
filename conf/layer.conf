## conf/layer.conf
```bitbake
# We have a conf and classes directory, add to BBPATH
BBPATH .= ":${LAYERDIR}"

# We have recipes-* directories, add to BBFILES
BBFILES += "${LAYERDIR}/recipes-*/*/*.bb \
            ${LAYERDIR}/recipes-*/*/*.bbappend"

BBFILE_COLLECTIONS += "meta-gpioblink"
BBFILE_PATTERN_meta-gpioblink = "^${LAYERDIR}/"
BBFILE_PRIORITY_meta-gpioblink = "6"

LAYERDEPENDS_meta-gpioblink = "core"
LAYERSERIES_COMPAT_meta-gpioblink = "scarthgap"
```
